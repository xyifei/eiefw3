/***********************************************************************************************************************
File: leds_anttt.c                                                                

Description:
***********************************************************************************************************************/

#include "configuration.h"


/***********************************************************************************************************************
Global variable definitions with scope across entire project.
All Global variable names shall start with "G_xxLed"
***********************************************************************************************************************/
/*--------------------------------------------------------------------------------------------------------------------*/
/* New variables (all shall start with G_xxLed*/


/*--------------------------------------------------------------------------------------------------------------------*/
/* External global variables defined in other files (must indicate which file they are defined in) */
extern volatile u32 G_u32SystemTime1ms;                /* From board-specific source file */
extern volatile u32 G_u32SystemTime1s;                 /* From board-specific source file */

extern volatile u32 G_u32ApplicationFlags;             /* From main.c */

u32 au32LedsAdr[] = {P0_26_LED_BLU, P0_27_LED_GRN, P0_28_LED_YLW, P0_29_LED_RED};
/***********************************************************************************************************************
Global variable definitions with scope limited to this local application.
Variable names shall start with "Led_" and be declared as static.
***********************************************************************************************************************/

 

/***********************************************************************************************************************
* Function Definitions
***********************************************************************************************************************/

/*--------------------------------------------------------------------------------------------------------------------*/
/* Public functions */
/*--------------------------------------------------------------------------------------------------------------------*/
void LedOn(eLedTypes eLedType)
{
	if( !LedCheckOn(eLedType) )
	{
		NRF_GPIO->OUTSET = au32LedsAdr[eLedType];
	}
	
}

void LedOff(eLedTypes eLedType)
{
	if( LedCheckOn(eLedType) )
	{
		NRF_GPIO->OUTCLR = au32LedsAdr[eLedType];
	}
	
}

void LedToggle(eLedTypes eLedType)
{
	if( LedCheckOn(eLedType) )
	{
		NRF_GPIO->OUTCLR = au32LedsAdr[eLedType];
	}
	else
	{
		NRF_GPIO->OUTSET = au32LedsAdr[eLedType];
	}
}

bool LedCheckOn(eLedTypes eLedType)
{
	if( NRF_GPIO->IN & au32LedsAdr[eLedType] )
	{
		return true;
	}
	else
	{
		return false;
	}
	
}


/*--------------------------------------------------------------------------------------------------------------------*/
/* Protected functions */
/*--------------------------------------------------------------------------------------------------------------------*/



/*--------------------------------------------------------------------------------------------------------------------*/
/* Private functions */
/*--------------------------------------------------------------------------------------------------------------------*/

  


/*--------------------------------------------------------------------------------------------------------------------*/
/* End of File */
/*--------------------------------------------------------------------------------------------------------------------*/


